/*
 * Novatek Ltd. NA51055 BSP part of dts
 *
 * Cortex-A9
 *
 */

&fastboot {
	iq_shading {
		version-info = [00 04 00 01];
		iq_shading {
			size = [60 42 00 00];
			data = [01 00 00 00 00 00 00 00 00 01 04 10 00 01 04 10 00 01 04 10 00 01 04 10 00 01 04 10 00 01 04 10 00 01 04 10 00 01 04 10 00 01 04 10 00 01 04 10 00 01 04 10 00 01 04 10 00 01 04 10 00 01 04 10 00 01 04 10 00 01 04 10 00 01 04 10 00 01 04 10 00 01 04 10 00 01 04 10 00 01 04 10 00 01 04 10 00 01 04 10 00 01 04 10 00 01 04 10 00 01 04 10 00 01 04 10 00 01 04 10 00 01 04 10 00 01 04 10 00 01 04 10 00 01 04 10 00 01 04 10 00 01 04 10 00 01 04 10 00 01 04 10 00 01 04 10 00 01 04 10 00 01 04 10 00 01 04 10 00 01 04 10 00 01 04 10 00 01 04 10 00 01 04 10 00 01 04 10 00 01 04 10 00 01 04 10 00 01 04 10 00 01 04 10 00 01 04 10 00 01 04 10 00 01 04 10 00 01 04 10 00 01 04 10 00 01 04 10 00 01 04 10 00 01 04 10 00 01 04 10 00 01 04 10 00 01 04 10 00 01 04 10 00 01 04 10 00 01 04 10 00 01 04 10 00 01 04 10 00 01 04 10 00 01 04 10 00 01 04 10 00 01 04 10 00 01 04 10 00 01 04 10 00 01 04 10 00 01 04 10 00 01 04 10 00 01 04 10 00 01 04 10 00 01 04 10 00 01 04 10 00 01 04 10 00 01 04 10 00 01 04 10 00 01 04 10 00 01 04 10 00 01 04 10 00 01 04 10 00 01 04 10 00 01 04 10 00 01 04 10 00 01 04 10 00 01 04 10 00 01 04 10 00 01 04 10 00 01 04 10 00 01 04 10 00 01 04 10 00 01 04 10 00 01 04 10 00 01 04 10 00 01 04 10 00 01 04 10 00 01 04 10 00 01 04 10 00 01 04 10 00 01 04 10 00 01 04 10 00 01 04 10 00 01 04 10 00 01 04 10 00 01 04 10 00 01 04 10 00 01 04 10 00 01 04 10 00 01 04 10 00 01 04 10 00 01 04 10 00 01 04 10 00 01 04 10 00 01 04 10 00 01 04 10 00 01 04 10 00 01 04 10 00 01 04 10 00 01 04 10 00 01 04 10 00 01 04 10 00 01 04 10 00 01 04 10 00 01 04 10 00 01 04 10 00 01 04 10 00 01 04 10 00 01 04 10 00 01 04 10 00 01 04 10 00 01 04 10 00 01 04 10 00 01 04 10 00 01 04 10 00 01 04 10 00 01 04 10 00 01 04 10 00 01 04 10 00 01 04 10 00 01 04 10 00 01 04 10 00 01 04 10 00 01 04 10 00 01 04 10 00 01 04 10 00 01 04 10 00 01 04 10 00 01 04 10 00 01 04 10 00 01 04 10 00 01 04 10 00 01 04 10 00 01 04 10 00 01 04 10 00 01 04 10 00 01 04 10 00 01 04 10 00 01 04 10 00 01 04 10 00 01 04 10 00 01 04 10 00 01 04 10 00 01 04 10 00 01 04 10 00 01 04 10 00 01 04 10 00 01 04 10 00 01 04 10 00 01 04 10 00 01 04 10 00 01 04 10 00 01 04 10 00 01 04 10 00 01 04 10 00 01 04 10 00 01 04 10 00 01 04 10 00 01 04 10 00 01 04 10 00 01 04 10 00 01 04 10 00 01 04 10 00 01 04 10 00 01 04 10 00 01 04 10 00 01 04 10 00 01 04 10 00 01 04 10 00 01 04 10 00 01 04 10 00 01 04 10 00 01 04 10 00 01 04 10 00 01 04 10 00 01 04 10 00 01 04 10 00 01 04 10 00 01 04 10 00 01 04 10 00 01 04 10 00 01 04 10 00 01 04 10 00 01 04 10 00 01 04 10 00 01 04 10 00 01 04 10 00 01 04 10 00 01 04 10 00 01 04 10 00 01 04 10 00 01 04 10 00 01 04 10 00 01 04 10 00 01 04 10 00 01 04 10 00 01 04 10 00 01 04 10 00 01 04 10 00 01 04 10 00 01 04 10 00 01 04 10 00 01 04 10 00 01 04 10 00 01 04 10 00 01 04 10 00 01 04 10 00 01 04 10 00 01 04 10 00 01 04 10 00 01 04 10 00 01 04 10 00 01 04 10 00 01 04 10 00 01 04 10 00 01 04 10 00 01 04 10 00 01 04 10 00 01 04 10 00 01 04 10 00 01 04 10 00 01 04 10 00 01 04 10 00 01 04 10 00 01 04 10 00 01 04 10 00 01 04 10 00 01 04 10 00 01 04 10 00 01 04 10 00 01 04 10 00 01 04 10 00 01 04 10 00 01 04 10 00 01 04 10 00 01 04 10 00 01 04 10 00 01 04 10 00 01 04 10 00 01 04 10 00 01 04 10 00 01 04 10 00 01 04 10 00 01 04 10 00 01 04 10 00 01 04 10 00 01 04 10 00 01 04 10 00 01 04 10 00 01 04 10 00 01 04 10 00 01 04 10 00 01 04 10 00 01 04 10 00 01 04 10 00 01 04 10 00 01 04 10 00 01 04 10 00 01 04 10 00 01 04 10 00 01 04 10 00 01 04 10 00 01 04 10 00 01 04 10 00 01 04 10 00 01 04 10 00 01 04 10 00 01 04 10 00 01 04 10 00 01 04 10 00 01 04 10 00 01 04 10 00 01 04 10 00 01 04 10 00 01 04 10 00 01 04 10 00 01 04 10 00 01 04 10 00 01 04 10 00 01 04 10 00 01 04 10 00 01 04 10 00 01 04 10 00 01 04 10 00 01 04 10 00 01 04 10 00 01 04 10 00 01 04 10 00 01 04 10 00 01 04 10 00 01 04 10 00 01 04 10 00 01 04 10 00 01 04 10 00 01 04 10 00 01 04 10 00 01 04 10 00 01 04 10 00 01 04 10 00 01 04 10 00 01 04 10 00 01 04 10 00 01 04 10 00 01 04 10 00 01 04 10 00 01 04 10 00 01 04 10 00 01 04 10 00 01 04 10 00 01 04 10 00 01 04 10 00 01 04 10 00 01 04 10 00 01 04 10 00 01 04 10 00 01 04 10 00 01 04 10 00 01 04 10 00 01 04 10 00 01 04 10 00 01 04 10 00 01 04 10 00 01 04 10 00 01 04 10 00 01 04 10 00 01 04 10 00 01 04 10 00 01 04 10 00 01 04 10 00 01 04 10 00 01 04 10 00 01 04 10 00 01 04 10 00 01 04 10 00 01 04 10 00 01 04 10 00 01 04 10 00 01 04 10 00 01 04 10 00 01 04 10 00 01 04 10 00 01 04 10 00 01 04 10 00 01 04 10 00 01 04 10 00 01 04 10 00 01 04 10 00 01 04 10 00 01 04 10 00 01 04 10 00 01 04 10 00 01 04 10 00 01 04 10 00 01 04 10 00 01 04 10 00 01 04 10 00 01 04 10 00 01 04 10 00 01 04 10 00 01 04 10 00 01 04 10 00 01 04 10 00 01 04 10 00 01 04 10 00 01 04 10 00 01 04 10 00 01 04 10 00 01 04 10 00 01 04 10 00 01 04 10 00 01 04 10 00 01 04 10 00 01 04 10 00 01 04 10 00 01 04 10 00 01 04 10 00 01 04 10 00 01 04 10 00 01 04 10 00 01 04 10 00 01 04 10 00 01 04 10 00 01 04 10 00 01 04 10 00 01 04 10 00 01 04 10 00 01 04 10 00 01 04 10 00 01 04 10 00 01 04 10 00 01 04 10 00 01 04 10 00 01 04 10 00 01 04 10 00 01 04 10 00 01 04 10 00 01 04 10 00 01 04 10 00 01 04 10 00 01 04 10 00 01 04 10 00 01 04 10 00 01 04 10 00 01 04 10 00 01 04 10 00 01 04 10 00 01 04 10 00 01 04 10 00 01 04 10 00 01 04 10 00 01 04 10 00 01 04 10 00 01 04 10 00 01 04 10 00 01 04 10 00 01 04 10 00 01 04 10 00 01 04 10 00 01 04 10 00 01 04 10 00 01 04 10 00 01 04 10 00 01 04 10 00 01 04 10 00 01 04 10 00 01 04 10 00 01 04 10 00 01 04 10 00 01 04 10 00 01 04 10 00 01 04 10 00 01 04 10 00 01 04 10 00 01 04 10 00 01 04 10 00 01 04 10 00 01 04 10 00 01 04 10 00 01 04 10 00 01 04 10 00 01 04 10 00 01 04 10 00 01 04 10 00 01 04 10 00 01 04 10 00 01 04 10 00 01 04 10 00 01 04 10 00 01 04 10 00 01 04 10 00 01 04 10 00 01 04 10 00 01 04 10 00 01 04 10 00 01 04 10 00 01 04 10 00 01 04 10 00 01 04 10 00 01 04 10 00 01 04 10 00 01 04 10 00 01 04 10 00 01 04 10 00 01 04 10 00 01 04 10 00 01 04 10 00 01 04 10 00 01 04 10 00 01 04 10 00 01 04 10 00 01 04 10 00 01 04 10 00 01 04 10 00 01 04 10 00 01 04 10 00 01 04 10 00 01 04 10 00 01 04 10 00 01 04 10 00 01 04 10 00 01 04 10 00 01 04 10 00 01 04 10 00 01 04 10 00 01 04 10 00 01 04 10 00 01 04 10 00 01 04 10 00 01 04 10 00 01 04 10 00 01 04 10 00 01 04 10 00 01 04 10 00 01 04 10 00 01 04 10 00 01 04 10 00 01 04 10 00 01 04 10 00 01 04 10 00 01 04 10 00 01 04 10 00 01 04 10 00 01 04 10 00 01 04 10 00 01 04 10 00 01 04 10 00 01 04 10 00 01 04 10 00 01 04 10 00 01 04 10 00 01 04 10 00 01 04 10 00 01 04 10 00 01 04 10 00 01 04 10 00 01 04 10 00 01 04 10 00 01 04 10 00 01 04 10 00 01 04 10 00 01 04 10 00 01 04 10 00 01 04 10 00 01 04 10 00 01 04 10 00 01 04 10 00 01 04 10 00 01 04 10 00 01 04 10 00 01 04 10 00 01 04 10 00 01 04 10 00 01 04 10 00 01 04 10 00 01 04 10 00 01 04 10 00 01 04 10 00 01 04 10 00 01 04 10 00 01 04 10 00 01 04 10 00 01 04 10 00 01 04 10 00 01 04 10 00 01 04 10 00 01 04 10 00 01 04 10 00 01 04 10 00 01 04 10 00 01 04 10 00 01 04 10 00 01 04 10 00 01 04 10 00 01 04 10 00 01 04 10 00 01 04 10 00 01 04 10 00 01 04 10 00 01 04 10 00 01 04 10 00 01 04 10 00 01 04 10 00 01 04 10 00 01 04 10 00 01 04 10 00 01 04 10 00 01 04 10 00 01 04 10 00 01 04 10 00 01 04 10 00 01 04 10 00 01 04 10 00 01 04 10 00 01 04 10 00 01 04 10 00 01 04 10 00 01 04 10 00 01 04 10 00 01 04 10 00 01 04 10 00 01 04 10 00 01 04 10 00 01 04 10 00 01 04 10 00 01 04 10 00 01 04 10 00 01 04 10 00 01 04 10 00 01 04 10 00 01 04 10 00 01 04 10 00 01 04 10 00 01 04 10 00 01 04 10 00 01 04 10 00 01 04 10 00 01 04 10 00 01 04 10 00 01 04 10 00 01 04 10 00 01 04 10 00 01 04 10 00 01 04 10 00 01 04 10 00 01 04 10 00 01 04 10 00 01 04 10 00 01 04 10 00 01 04 10 00 01 04 10 00 01 04 10 00 01 04 10 00 01 04 10 00 01 04 10 00 01 04 10 00 01 04 10 00 01 04 10 00 01 04 10 00 01 04 10 00 01 04 10 00 01 04 10 00 01 04 10 00 01 04 10 00 01 04 10 00 01 04 10 00 01 04 10 00 01 04 10 00 01 04 10 00 01 04 10 00 01 04 10 00 01 04 10 00 01 04 10 00 01 04 10 00 01 04 10 00 01 04 10 00 01 04 10 00 01 04 10 00 01 04 10 00 01 04 10 00 01 04 10 00 01 04 10 00 01 04 10 00 01 04 10 00 01 04 10 00 01 04 10 00 01 04 10 00 01 04 10 00 01 04 10 00 01 04 10 00 01 04 10 00 01 04 10 00 01 04 10 00 01 04 10 00 01 04 10 00 01 04 10 00 01 04 10 00 01 04 10 00 01 04 10 00 01 04 10 00 01 04 10 00 01 04 10 00 01 04 10 00 01 04 10 00 01 04 10 00 01 04 10 00 01 04 10 00 01 04 10 00 01 04 10 00 01 04 10 00 01 04 10 00 01 04 10 00 01 04 10 00 01 04 10 00 01 04 10 00 01 04 10 00 01 04 10 00 01 04 10 00 01 04 10 00 01 04 10 00 01 04 10 00 01 04 10 00 01 04 10 00 01 04 10 00 01 04 10 00 01 04 10 00 01 04 10 00 01 04 10 00 01 04 10 00 01 04 10 00 01 04 10 00 01 04 10 00 01 04 10 00 01 04 10 00 01 04 10 00 01 04 10 00 01 04 10 00 01 04 10 00 01 04 10 00 01 04 10 00 01 04 10 00 01 04 10 00 01 04 10 00 01 04 10 00 01 04 10 00 01 04 10 00 01 04 10 00 01 04 10 00 01 04 10 00 01 04 10 00 01 04 10 00 01 04 10 00 01 04 10 00 01 04 10 00 01 04 10 00 01 04 10 00 01 04 10 00 01 04 10 00 01 04 10 00 01 04 10 00 01 04 10 00 01 04 10 00 01 04 10 00 01 04 10 00 01 04 10 00 01 04 10 00 01 04 10 00 01 04 10 00 01 04 10 00 01 04 10 00 01 04 10 00 01 04 10 00 01 04 10 00 01 04 10 00 01 04 10 00 01 04 10 00 01 04 10 00 01 04 10 00 01 04 10 00 01 04 10 00 01 04 10 00 01 04 10 00 01 04 10 00 01 04 10 00 01 04 10 00 01 04 10 00 01 04 10 00 01 04 10 00 01 04 10 00 01 04 10 00 01 04 10 00 01 04 10 00 01 04 10 00 01 04 10 00 01 04 10 00 01 04 10 00 01 04 10 00 01 04 10 00 01 04 10 00 01 04 10 00 01 04 10 00 01 04 10 00 01 04 10 00 01 04 10 00 01 04 10 00 01 04 10 00 01 04 10 00 01 04 10 00 01 04 10 00 01 04 10 00 01 04 10 00 01 04 10 00 01 04 10 00 01 04 10 00 01 04 10 00 01 04 10 00 01 04 10 00 01 04 10 00 01 04 10 00 01 04 10 00 01 04 10 00 01 04 10 00 01 04 10 00 01 04 10 00 01 04 10 00 01 04 10 00 01 04 10 00 01 04 10 00 01 04 10 00 01 04 10 00 01 04 10 00 01 04 10 00 01 04 10 00 01 04 10 00 01 04 10 00 01 04 10 00 01 04 10 00 01 04 10 00 01 04 10 00 01 04 10 00 01 04 10 00 01 04 10 00 01 04 10 00 01 04 10 00 01 04 10 00 01 04 10 00 01 04 10 00 01 04 10 00 01 04 10 00 01 04 10 00 01 04 10 00 01 04 10 00 01 04 10 00 01 04 10 00 01 04 10 00 01 04 10 00 01 04 10 00 01 04 10 00 01 04 10 00 01 04 10 00 01 04 10 00 01 04 10 00 01 04 10 00 01 04 10 00 01 04 10 00 01 04 10 00 01 04 10 00 01 04 10 00 01 04 10 00 01 04 10 00 01 04 10 00 01 04 10 00 01 04 10 00 01 04 10 00 01 04 10 00 01 04 10 00 01 04 10 00 01 04 10 00 01 04 10 00 01 04 10 00 01 04 10 00 01 04 10 00 01 04 10 00 01 04 10 00 01 04 10 00 01 04 10 00 01 04 10 00 01 04 10 00 01 04 10 00 01 04 10 00 01 04 10 00 01 04 10 00 01 04 10 00 01 04 10 00 01 04 10 00 01 04 10 00 01 04 10 00 01 04 10 00 01 04 10 00 01 04 10 00 01 04 10 00 01 04 10 00 01 04 10 00 01 04 10 00 01 04 10 00 01 04 10 00 01 04 10 00 01 04 10 00 01 04 10 00 01 04 10 00 01 04 10 00 01 04 10 00 01 04 10 00 01 04 10 00 01 04 10 00 01 04 10 00 01 04 10 00 01 04 10 00 01 04 10 00 01 04 10 00 01 04 10 00 01 04 10 00 01 04 10 00 01 04 10 00 01 04 10 00 01 04 10 00 01 04 10 00 01 04 10 00 01 04 10 00 01 04 10 00 01 04 10 00 01 04 10 00 01 04 10 00 01 04 10 00 01 04 10 00 01 04 10 00 01 04 10 00 01 04 10 00 01 04 10 00 01 04 10 00 01 04 10 00 01 04 10 00 01 04 10 00 01 04 10 00 01 04 10 00 01 04 10 00 01 04 10 00 01 04 10 00 01 04 10 00 01 04 10 00 01 04 10 00 01 04 10 00 01 04 10 00 01 04 10 00 01 04 10 00 01 04 10 00 01 04 10 00 01 04 10 00 01 04 10 00 01 04 10 00 01 04 10 00 01 04 10 00 01 04 10 00 01 04 10 00 01 04 10 00 01 04 10 00 01 04 10 00 01 04 10 00 01 04 10 00 01 04 10 00 01 04 10 00 01 04 10 00 01 04 10 00 01 04 10 00 01 04 10 00 01 04 10 00 01 04 10 00 01 04 10 00 01 04 10 00 01 04 10 00 01 04 10 00 01 04 10 00 01 04 10 00 01 04 10 00 01 04 10 00 01 04 10 00 01 04 10 00 01 04 10 00 01 04 10 00 01 04 10 00 01 04 10 00 01 04 10 00 01 04 10 00 01 04 10 00 01 04 10 00 01 04 10 00 01 04 10 00 01 04 10 00 01 04 10 00 01 04 10 00 01 04 10 00 01 04 10 00 01 04 10 00 01 04 10 00 01 04 10 00 01 04 10 00 01 04 10 00 01 04 10 00 01 04 10 00 01 04 10 00 01 04 10 00 01 04 10 00 01 04 10 00 01 04 10 00 01 04 10 00 01 04 10 00 01 04 10 00 01 04 10 00 01 04 10 00 01 04 10 00 01 04 10 00 01 04 10 00 01 04 10 00 01 04 10 00 01 04 10 00 01 04 10 00 01 04 10 00 01 04 10 00 01 04 10 00 01 04 10 00 01 04 10 00 01 04 10 00 01 04 10 00 01 04 10 00 01 04 10 00 01 04 10 00 01 04 10 00 01 04 10 00 01 04 10 00 01 04 10 00 01 04 10 00 01 04 10 00 01 04 10 00 01 04 10 00 01 04 10 00 01 04 10 00 01 04 10 00 01 04 10 00 01 04 10 00 01 04 10 00 01 04 10 00 01 04 10 00 01 04 10 00 01 04 10 00 01 04 10 00 01 04 10 00 01 04 10 00 01 04 10 00 01 04 10 00 01 04 10 00 01 04 10 00 01 04 10 00 01 04 10 00 01 04 10 00 01 04 10 00 01 04 10 00 01 04 10 00 01 04 10 00 01 04 10 00 01 04 10 00 01 04 10 00 01 04 10 00 01 04 10 00 01 04 10 00 01 04 10 00 01 04 10 00 01 04 10 00 01 04 10 00 01 04 10 00 01 04 10 00 01 04 10 00 01 04 10 00 01 04 10 00 01 04 10 00 01 04 10 00 01 04 10 00 01 04 10 00 01 04 10 00 01 04 10 00 01 04 10 00 01 04 10 00 01 04 10 00 01 04 10 00 01 04 10 00 01 04 10 00 01 04 10 00 01 04 10 00 01 04 10 00 01 04 10 00 01 04 10 00 01 04 10 00 01 04 10 00 01 04 10 00 01 04 10 00 01 04 10 00 01 04 10 00 01 04 10 00 01 04 10 00 01 04 10 00 01 04 10 00 01 04 10 00 01 04 10 00 01 04 10 00 01 04 10 00 01 04 10 00 01 04 10 00 01 04 10 00 01 04 10 00 01 04 10 00 01 04 10 00 01 04 10 00 01 04 10 00 01 04 10 00 01 04 10 00 01 04 10 00 01 04 10 00 01 04 10 00 01 04 10 00 01 04 10 00 01 04 10 00 01 04 10 00 01 04 10 00 01 04 10 00 01 04 10 00 01 04 10 00 01 04 10 00 01 04 10 00 01 04 10 00 01 04 10 00 01 04 10 00 01 04 10 00 01 04 10 00 01 04 10 00 01 04 10 00 01 04 10 00 01 04 10 00 01 04 10 00 01 04 10 00 01 04 10 00 01 04 10 00 01 04 10 00 01 04 10 00 01 04 10 00 01 04 10 00 01 04 10 00 01 04 10 00 01 04 10 00 01 04 10 00 01 04 10 00 01 04 10 00 01 04 10 00 01 04 10 00 01 04 10 00 01 04 10 00 01 04 10 00 01 04 10 00 01 04 10 00 01 04 10 00 01 04 10 00 01 04 10 00 01 04 10 00 01 04 10 00 01 04 10 00 01 04 10 00 01 04 10 00 01 04 10 00 01 04 10 00 01 04 10 00 01 04 10 00 01 04 10 00 01 04 10 00 01 04 10 00 01 04 10 00 01 04 10 00 01 04 10 00 01 04 10 00 01 04 10 00 01 04 10 00 01 04 10 00 01 04 10 00 01 04 10 00 01 04 10 00 01 04 10 00 01 04 10 00 01 04 10 00 01 04 10 00 01 04 10 00 01 04 10 00 01 04 10 00 01 04 10 00 01 04 10 00 01 04 10 00 01 04 10 00 01 04 10 00 01 04 10 00 01 04 10 00 01 04 10 00 01 04 10 00 01 04 10 00 01 04 10 00 01 04 10 00 01 04 10 00 01 04 10 00 01 04 10 00 01 04 10 00 01 04 10 00 01 04 10 00 01 04 10 00 01 04 10 00 01 04 10 00 01 04 10 00 01 04 10 00 01 04 10 00 01 04 10 00 01 04 10 00 01 04 10 00 01 04 10 00 01 04 10 00 01 04 10 00 01 04 10 00 01 04 10 00 01 04 10 00 01 04 10 00 01 04 10 00 01 04 10 00 01 04 10 00 01 04 10 00 01 04 10 00 01 04 10 00 01 04 10 00 01 04 10 00 01 04 10 00 01 04 10 00 01 04 10 00 01 04 10 00 01 04 10 00 01 04 10 00 01 04 10 00 01 04 10 00 01 04 10 00 01 04 10 00 01 04 10 00 01 04 10 00 01 04 10 00 01 04 10 00 01 04 10 00 01 04 10 00 01 04 10 00 01 04 10 00 01 04 10 00 01 04 10 00 01 04 10 00 01 04 10 00 01 04 10 00 01 04 10 00 01 04 10 00 01 04 10 00 01 04 10 00 01 04 10 00 01 04 10 00 01 04 10 00 01 04 10 00 01 04 10 00 01 04 10 00 01 04 10 00 01 04 10 00 01 04 10 00 01 04 10 00 01 04 10 00 01 04 10 00 01 04 10 00 01 04 10 00 01 04 10 00 01 04 10 00 01 04 10 00 01 04 10 00 01 04 10 00 01 04 10 00 01 04 10 00 01 04 10 00 01 04 10 00 01 04 10 00 01 04 10 00 01 04 10 00 01 04 10 00 01 04 10 00 01 04 10 00 01 04 10 00 01 04 10 00 01 04 10 00 01 04 10 00 01 04 10 00 01 04 10 00 01 04 10 00 01 04 10 00 01 04 10 00 01 04 10 00 01 04 10 00 01 04 10 00 01 04 10 00 01 04 10 00 01 04 10 00 01 04 10 00 01 04 10 00 01 04 10 00 01 04 10 00 01 04 10 00 01 04 10 00 01 04 10 00 01 04 10 00 01 04 10 00 01 04 10 00 01 04 10 00 01 04 10 00 01 04 10 00 01 04 10 00 01 04 10 00 01 04 10 00 01 04 10 00 01 04 10 00 01 04 10 00 01 04 10 00 01 04 10 00 01 04 10 00 01 04 10 00 01 04 10 00 01 04 10 00 01 04 10 00 01 04 10 00 01 04 10 00 01 04 10 00 01 04 10 00 01 04 10 00 01 04 10 00 01 04 10 00 01 04 10 00 01 04 10 00 01 04 10 00 01 04 10 00 01 04 10 00 01 04 10 00 01 04 10 00 01 04 10 00 01 04 10 00 01 04 10 00 01 04 10 00 01 04 10 00 01 04 10 00 01 04 10 00 01 04 10 00 01 04 10 00 01 04 10 00 01 04 10 00 01 04 10 00 01 04 10 00 01 04 10 00 01 04 10 00 01 04 10 00 01 04 10 00 01 04 10 00 01 04 10 00 01 04 10 00 01 04 10 00 01 04 10 00 01 04 10 00 01 04 10 00 01 04 10 00 01 04 10 00 01 04 10 00 01 04 10 00 01 04 10 00 01 04 10 00 01 04 10 00 01 04 10 00 01 04 10 00 01 04 10 00 01 04 10 00 01 04 10 00 01 04 10 00 01 04 10 00 01 04 10 00 01 04 10 00 01 04 10 00 01 04 10 00 01 04 10 00 01 04 10 00 01 04 10 00 01 04 10 00 01 04 10 00 01 04 10 00 01 04 10 00 01 04 10 00 01 04 10 00 01 04 10 00 01 04 10 00 01 04 10 00 01 04 10 00 01 04 10 00 01 04 10 00 01 04 10 00 01 04 10 00 01 04 10 00 01 04 10 00 01 04 10 00 01 04 10 00 01 04 10 00 01 04 10 00 01 04 10 00 01 04 10 00 01 04 10 00 01 04 10 00 01 04 10 00 01 04 10 00 01 04 10 00 01 04 10 00 01 04 10 00 01 04 10 00 01 04 10 00 01 04 10 00 01 04 10 00 01 04 10 00 01 04 10 00 01 04 10 00 01 04 10 00 01 04 10 00 01 04 10 00 01 04 10 00 01 04 10 00 01 04 10 00 01 04 10 00 01 04 10 00 01 04 10 00 01 04 10 00 01 04 10 00 01 04 10 00 01 04 10 00 01 04 10 00 01 04 10 00 01 04 10 00 01 04 10 00 01 04 10 00 01 04 10 00 01 04 10 00 01 04 10 00 01 04 10 00 01 04 10 00 01 04 10 00 01 04 10 00 01 04 10 00 01 04 10 00 01 04 10 00 01 04 10 00 01 04 10 00 01 04 10 00 01 04 10 00 01 04 10 00 01 04 10 00 01 04 10 00 01 04 10 00 01 04 10 00 01 04 10 00 01 04 10 00 01 04 10 00 01 04 10 00 01 04 10 00 01 04 10 00 01 04 10 00 01 04 10 00 01 04 10 00 01 04 10 00 01 04 10 00 01 04 10 00 01 04 10 00 01 04 10 00 01 04 10 00 01 04 10 00 01 04 10 00 01 04 10 00 01 04 10 00 01 04 10 00 01 04 10 00 01 04 10 00 01 04 10 00 01 04 10 00 01 04 10 00 01 04 10 00 01 04 10 00 01 04 10 00 01 04 10 00 01 04 10 00 01 04 10 00 01 04 10 00 01 04 10 00 01 04 10 00 01 04 10 00 01 04 10 00 01 04 10 00 01 04 10 00 01 04 10 00 01 04 10 00 01 04 10 00 01 04 10 00 01 04 10 00 01 04 10 00 01 04 10 00 01 04 10 00 01 04 10 00 01 04 10 00 01 04 10 00 01 04 10 00 01 04 10 00 01 04 10 00 01 04 10 00 01 04 10 00 01 04 10 00 01 04 10 00 01 04 10 00 01 04 10 00 01 04 10 00 01 04 10 00 01 04 10 00 01 04 10 00 01 04 10 00 01 04 10 00 01 04 10 00 01 04 10 00 01 04 10 00 01 04 10 00 01 04 10 00 01 04 10 00 01 04 10 00 01 04 10 00 01 04 10 00 01 04 10 00 01 04 10 00 01 04 10 00 01 04 10 00 01 04 10 00 01 04 10 00 01 04 10 00 01 04 10 00 01 04 10 00 01 04 10 00 01 04 10 00 01 04 10 00 01 04 10 00 01 04 10 00 01 04 10 00 01 04 10 00 01 04 10 00 01 04 10 00 01 04 10 00 01 04 10 00 01 04 10 00 01 04 10 00 01 04 10 00 01 04 10 00 01 04 10 00 01 04 10 00 01 04 10 00 01 04 10 00 01 04 10 00 01 04 10 00 01 04 10 00 01 04 10 00 01 04 10 00 01 04 10 00 01 04 10 00 01 04 10 00 01 04 10 00 01 04 10 00 01 04 10 00 01 04 10 00 01 04 10 00 01 04 10 00 01 04 10 00 01 04 10 00 01 04 10 00 01 04 10 00 01 04 10 00 01 04 10 00 01 04 10 00 01 04 10 00 01 04 10 00 01 04 10 00 01 04 10 00 01 04 10 00 01 04 10 00 01 04 10 00 01 04 10 00 01 04 10 00 01 04 10 00 01 04 10 00 01 04 10 00 01 04 10 00 01 04 10 00 01 04 10 00 01 04 10 00 01 04 10 00 01 04 10 00 01 04 10 00 01 04 10 00 01 04 10 00 01 04 10 00 01 04 10 00 01 04 10 00 01 04 10 00 01 04 10 00 01 04 10 00 01 04 10 00 01 04 10 00 01 04 10 00 01 04 10 00 01 04 10 00 01 04 10 00 01 04 10 00 01 04 10 00 01 04 10 00 01 04 10 00 01 04 10 00 01 04 10 00 01 04 10 00 01 04 10 00 01 04 10 00 01 04 10 00 01 04 10 00 01 04 10 00 01 04 10 00 01 04 10 00 01 04 10 00 01 04 10 00 01 04 10 00 01 04 10 00 01 04 10 00 01 04 10 00 01 04 10 00 01 04 10 00 01 04 10 00 01 04 10 00 01 04 10 00 01 04 10 00 01 04 10 00 01 04 10 00 01 04 10 00 01 04 10 00 01 04 10 00 01 04 10 00 01 04 10 00 01 04 10 00 01 04 10 00 01 04 10 00 01 04 10 00 01 04 10 00 01 04 10 00 01 04 10 00 01 04 10 00 01 04 10 00 01 04 10 00 01 04 10 00 01 04 10 00 01 04 10 00 01 04 10 00 01 04 10 00 01 04 10 00 01 04 10 00 01 04 10 00 01 04 10 00 01 04 10 00 01 04 10 00 01 04 10 00 01 04 10 00 01 04 10 00 01 04 10 00 01 04 10 00 01 04 10 00 01 04 10 00 01 04 10 00 01 04 10 00 01 04 10 00 01 04 10 00 01 04 10 00 01 04 10 00 01 04 10 00 01 04 10 00 01 04 10 00 01 04 10 00 01 04 10 00 01 04 10 00 01 04 10 00 01 04 10 00 01 04 10 00 01 04 10 00 01 04 10 00 01 04 10 00 01 04 10 00 01 04 10 00 01 04 10 00 01 04 10 00 01 04 10 00 01 04 10 00 01 04 10 00 01 04 10 00 01 04 10 00 01 04 10 00 01 04 10 00 01 04 10 00 01 04 10 00 01 04 10 00 01 04 10 00 01 04 10 00 01 04 10 00 01 04 10 00 01 04 10 00 01 04 10 00 01 04 10 00 01 04 10 00 01 04 10 00 01 04 10 00 01 04 10 00 01 04 10 00 01 04 10 00 01 04 10 00 01 04 10 00 01 04 10 00 01 04 10 00 01 04 10 00 01 04 10 00 01 04 10 00 01 04 10 00 01 04 10 00 01 04 10 00 01 04 10 00 01 04 10 00 01 04 10 00 01 04 10 00 01 04 10 00 01 04 10 00 01 04 10 00 01 04 10 00 01 04 10 00 01 04 10 00 01 04 10 00 01 04 10 00 01 04 10 00 01 04 10 00 01 04 10 00 01 04 10 00 01 04 10 00 01 04 10 00 01 04 10 00 01 04 10 00 01 04 10 00 01 04 10 00 01 04 10 00 01 04 10 00 01 04 10 00 01 04 10 00 01 04 10 00 01 04 10 00 01 04 10 00 01 04 10 00 01 04 10 00 01 04 10 00 01 04 10 00 01 04 10 00 01 04 10 00 01 04 10 00 01 04 10 00 01 04 10 00 01 04 10 00 01 04 10 00 01 04 10 00 01 04 10 00 01 04 10 00 01 04 10 00 01 04 10 00 01 04 10 00 01 04 10 00 01 04 10 00 01 04 10 00 01 04 10 00 01 04 10 00 01 04 10 00 01 04 10 00 01 04 10 00 01 04 10 00 01 04 10 00 01 04 10 00 01 04 10 00 01 04 10 00 01 04 10 00 01 04 10 00 01 04 10 00 01 04 10 00 01 04 10 00 01 04 10 00 01 04 10 00 01 04 10 00 01 04 10 00 01 04 10 00 01 04 10 00 01 04 10 00 01 04 10 00 01 04 10 00 01 04 10 00 01 04 10 00 01 04 10 00 01 04 10 00 01 04 10 00 01 04 10 00 01 04 10 00 01 04 10 00 01 04 10 00 01 04 10 00 01 04 10 00 01 04 10 00 01 04 10 00 01 04 10 00 01 04 10 00 01 04 10 00 01 04 10 00 01 04 10 00 01 04 10 00 01 04 10 00 01 04 10 00 01 04 10 00 01 04 10 00 01 04 10 00 01 04 10 00 01 04 10 00 01 04 10 00 01 04 10 00 01 04 10 00 01 04 10 00 01 04 10 00 01 04 10 00 01 04 10 00 01 04 10 00 01 04 10 00 01 04 10 00 01 04 10 00 01 04 10 00 01 04 10 00 01 04 10 00 01 04 10 00 01 04 10 00 01 04 10 00 01 04 10 00 01 04 10 00 01 04 10 00 01 04 10 00 01 04 10 00 01 04 10 00 01 04 10 00 01 04 10 00 01 04 10 00 01 04 10 00 01 04 10 00 01 04 10 00 01 04 10 00 01 04 10 00 01 04 10 00 01 04 10 00 01 04 10 00 01 04 10 00 01 04 10 00 01 04 10 00 01 04 10 00 01 04 10 00 01 04 10 00 01 04 10 00 01 04 10 00 01 04 10 00 01 04 10 00 01 04 10 00 01 04 10 00 01 04 10 00 01 04 10 00 01 04 10 00 01 04 10 00 01 04 10 00 01 04 10 00 01 04 10 00 01 04 10 00 01 04 10 00 01 04 10 00 01 04 10 00 01 04 10 00 01 04 10 00 01 04 10 00 01 04 10 00 01 04 10 00 01 04 10 00 01 04 10 00 01 04 10 00 01 04 10 00 01 04 10 00 01 04 10 00 01 04 10 00 01 04 10 00 01 04 10 00 01 04 10 00 01 04 10 00 01 04 10 00 01 04 10 00 01 04 10 00 01 04 10 00 01 04 10 00 01 04 10 00 01 04 10 00 01 04 10 00 01 04 10 00 01 04 10 00 01 04 10 00 01 04 10 00 01 04 10 00 01 04 10 00 01 04 10 00 01 04 10 00 01 04 10 00 01 04 10 00 01 04 10 00 01 04 10 00 01 04 10 00 01 04 10 00 01 04 10 00 01 04 10 00 01 04 10 00 01 04 10 00 01 04 10 00 01 04 10 00 01 04 10 00 01 04 10 00 01 04 10 00 01 04 10 00 01 04 10 00 01 04 10 00 01 04 10 00 01 04 10 00 01 04 10 00 01 04 10 00 01 04 10 00 01 04 10 00 01 04 10 00 01 04 10 00 01 04 10 00 01 04 10 00 01 04 10 00 01 04 10 00 01 04 10 00 01 04 10 00 01 04 10 00 01 04 10 00 01 04 10 00 01 04 10 00 01 04 10 00 01 04 10 00 01 04 10 00 01 04 10 00 01 04 10 00 01 04 10 00 01 04 10 00 01 04 10 00 01 04 10 00 01 04 10 00 01 04 10 00 01 04 10 00 01 04 10 00 01 04 10 00 01 04 10 00 01 04 10 00 01 04 10 00 01 04 10 00 01 04 10 00 01 04 10 00 01 04 10 00 01 04 10 00 01 04 10 00 01 04 10 00 01 04 10 00 01 04 10 00 01 04 10 00 01 04 10 00 01 04 10 00 01 04 10 00 01 04 10 00 01 04 10 00 01 04 10 00 01 04 10 00 01 04 10 00 01 04 10 00 01 04 10 00 01 04 10 00 01 04 10 00 01 04 10 00 01 04 10 00 01 04 10 00 01 04 10 00 01 04 10 00 01 04 10 00 01 04 10 00 01 04 10 00 01 04 10 00 01 04 10 00 01 04 10 00 01 04 10 00 01 04 10 00 01 04 10 00 01 04 10 00 01 04 10 00 01 04 10 00 01 04 10 00 01 04 10 00 01 04 10 00 01 04 10 00 01 04 10 00 01 04 10 00 01 04 10 00 01 04 10 00 01 04 10 00 01 04 10 00 01 04 10 00 01 04 10 00 01 04 10 00 01 04 10 00 01 04 10 00 01 04 10 00 01 04 10 00 01 04 10 00 01 04 10 00 01 04 10 00 01 04 10 00 01 04 10 00 01 04 10 00 01 04 10 00 01 04 10 00 01 04 10 00 01 04 10 00 01 04 10 00 01 04 10 00 01 04 10 00 01 04 10 00 01 04 10 00 01 04 10 00 01 04 10 00 01 04 10 00 01 04 10 00 01 04 10 00 01 04 10 00 01 04 10 00 01 04 10 00 01 04 10 00 01 04 10 00 01 04 10 00 01 04 10 00 01 04 10 00 01 04 10 00 01 04 10 00 01 04 10 00 01 04 10 00 01 04 10 00 01 04 10 00 01 04 10 00 01 04 10 00 01 04 10 00 01 04 10 00 01 04 10 00 01 04 10 00 01 04 10 00 01 04 10 00 01 04 10 00 01 04 10 00 01 04 10 00 01 04 10 00 01 04 10 00 01 04 10 00 01 04 10 00 01 04 10 00 01 04 10 00 01 04 10 00 01 04 10 00 01 04 10 00 01 04 10 00 01 04 10 00 01 04 10 00 01 04 10 00 01 04 10 00 01 04 10 00 01 04 10 00 01 04 10 00 01 04 10 00 01 04 10 00 01 04 10 00 01 04 10 00 01 04 10 00 01 04 10 00 01 04 10 00 01 04 10 00 01 04 10 00 01 04 10 00 01 04 10 00 01 04 10 00 01 04 10 00 01 04 10 00 01 04 10 00 01 04 10 00 01 04 10 00 01 04 10 00 01 04 10 00 01 04 10 00 01 04 10 00 01 04 10 00 01 04 10 00 01 04 10 00 01 04 10 00 01 04 10 00 01 04 10 00 01 04 10 00 01 04 10 00 01 04 10 00 01 04 10 00 01 04 10 00 01 04 10 00 01 04 10 00 01 04 10 00 01 04 10 00 01 04 10 00 01 04 10 00 01 04 10 00 01 04 10 00 01 04 10 00 01 04 10 00 01 04 10 00 01 04 10 00 01 04 10 00 01 04 10 00 01 04 10 00 01 04 10 00 01 04 10 00 01 04 10 00 01 04 10 00 01 04 10 00 01 04 10 00 01 04 10 00 01 04 10 00 01 04 10 00 01 04 10 00 01 04 10 00 01 04 10 00 01 04 10 00 01 04 10 00 01 04 10 00 01 04 10 00 01 04 10 00 01 04 10 00 01 04 10 00 01 04 10 00 01 04 10 00 01 04 10 00 01 04 10 00 01 04 10 00 01 04 10 00 01 04 10 00 01 04 10 00 01 04 10 00 01 04 10 00 01 04 10 00 01 04 10 00 01 04 10 00 01 04 10 00 01 04 10 00 01 04 10 00 01 04 10 00 01 04 10 00 01 04 10 00 01 04 10 00 01 04 10 00 01 04 10 00 01 04 10 00 01 04 10 00 01 04 10 00 01 04 10 00 01 04 10 00 01 04 10 00 01 04 10 00 01 04 10 00 01 04 10 00 01 04 10 00 01 04 10 00 01 04 10 00 01 04 10 00 01 04 10 00 01 04 10 00 01 04 10 00 01 04 10 00 01 04 10 00 01 04 10 00 01 04 10 00 01 04 10 00 01 04 10 00 01 04 10 00 01 04 10 00 01 04 10 00 01 04 10 00 01 04 10 00 01 04 10 00 01 04 10 00 01 04 10 00 01 04 10 00 01 04 10 00 01 04 10 00 01 04 10 00 01 04 10 00 01 04 10 00 01 04 10 00 01 04 10 00 01 04 10 00 01 04 10 00 01 04 10 00 01 04 10 00 01 04 10 00 01 04 10 00 01 04 10 00 01 04 10 00 01 04 10 00 01 04 10 00 01 04 10 00 01 04 10 00 01 04 10 00 01 04 10 00 01 04 10 00 01 04 10 00 01 04 10 00 01 04 10 00 01 04 10 00 01 04 10 00 01 04 10 00 01 04 10 00 01 04 10 00 01 04 10 00 01 04 10 00 01 04 10 00 01 04 10 00 01 04 10 00 01 04 10 00 01 04 10 00 01 04 10 00 01 04 10 00 01 04 10 00 01 04 10 00 01 04 10 00 01 04 10 00 01 04 10 00 01 04 10 00 01 04 10 00 01 04 10 00 01 04 10 00 01 04 10 00 01 04 10 00 01 04 10 00 01 04 10 00 01 04 10 00 01 04 10 00 01 04 10 00 01 04 10 00 01 04 10 00 01 04 10 00 01 04 10 00 01 04 10 00 01 04 10 00 01 04 10 00 01 04 10 00 01 04 10 00 01 04 10 00 01 04 10 00 01 04 10 00 01 04 10 00 01 04 10 00 01 04 10 00 01 04 10 00 01 04 10 00 01 04 10 00 01 04 10 00 01 04 10 00 01 04 10 00 01 04 10 00 01 04 10 00 01 04 10 00 01 04 10 00 01 04 10 00 01 04 10 00 01 04 10 00 01 04 10 00 01 04 10 00 01 04 10 00 01 04 10 00 01 04 10 00 01 04 10 00 01 04 10 00 01 04 10 00 01 04 10 00 01 04 10 00 01 04 10 00 01 04 10 00 01 04 10 00 01 04 10 00 01 04 10 00 01 04 10 00 01 04 10 00 01 04 10 00 01 04 10 00 01 04 10 00 01 04 10 00 01 04 10 00 01 04 10 00 01 04 10 00 01 04 10 00 01 04 10 00 01 04 10 00 01 04 10 00 01 04 10 00 01 04 10 00 01 04 10 00 01 04 10 00 01 04 10 00 01 04 10 00 01 04 10 00 01 04 10 00 01 04 10 00 01 04 10 00 01 04 10 00 01 04 10 00 01 04 10 00 01 04 10 00 01 04 10 00 01 04 10 00 01 04 10 00 01 04 10 00 01 04 10 00 01 04 10 00 01 04 10 00 01 04 10 00 01 04 10 00 01 04 10 00 01 04 10 00 01 04 10 00 01 04 10 00 01 04 10 00 01 04 10 00 01 04 10 00 01 04 10 00 01 04 10 00 01 04 10 00 01 04 10 00 01 04 10 00 01 04 10 00 01 04 10 00 01 04 10 00 01 04 10 00 01 04 10 00 01 04 10 00 01 04 10 00 01 04 10 00 01 04 10 00 01 04 10 00 01 04 10 00 01 04 10 00 01 04 10 00 01 04 10 00 01 04 10 00 01 04 10 00 01 04 10 00 01 04 10 00 01 04 10 00 01 04 10 00 01 04 10 00 01 04 10 00 01 04 10 00 01 04 10 00 01 04 10 00 01 04 10 00 01 04 10 00 01 04 10 00 01 04 10 00 01 04 10 00 01 04 10 00 01 04 10 00 01 04 10 00 01 04 10 00 01 04 10 00 01 04 10 00 01 04 10 00 01 04 10 00 01 04 10 00 01 04 10 00 01 04 10 00 01 04 10 00 01 04 10 00 01 04 10 00 01 04 10 00 01 04 10 00 01 04 10 00 01 04 10 00 01 04 10 00 01 04 10 00 01 04 10 00 01 04 10 00 01 04 10 00 01 04 10 00 01 04 10 00 01 04 10 00 01 04 10 00 01 04 10 00 01 04 10 00 01 04 10 00 01 04 10 00 01 04 10 00 01 04 10 00 01 04 10 00 01 04 10 00 01 04 10 00 01 04 10 00 01 04 10 00 01 04 10 00 01 04 10 00 01 04 10 00 01 04 10 00 01 04 10 00 01 04 10 00 01 04 10 00 01 04 10 00 01 04 10 00 01 04 10 00 01 04 10 00 01 04 10 00 01 04 10 00 01 04 10 00 01 04 10 00 01 04 10 00 01 04 10 00 01 04 10 00 01 04 10 00 01 04 10 00 01 04 10 00 01 04 10 00 01 04 10 00 01 04 10 00 01 04 10 00 01 04 10 00 01 04 10 00 01 04 10 00 01 04 10 00 01 04 10 00 01 04 10 00 01 04 10 00 01 04 10 00 01 04 10 00 01 04 10 00 01 04 10 00 01 04 10 00 01 04 10 00 01 04 10 00 01 04 10 00 01 04 10 00 01 04 10 00 01 04 10 00 01 04 10 00 01 04 10 00 01 04 10 00 01 04 10 00 01 04 10 00 01 04 10 00 01 04 10 00 01 04 10 00 01 04 10 00 01 04 10 00 01 04 10 00 01 04 10 00 01 04 10 00 01 04 10 00 01 04 10 00 01 04 10 00 01 04 10 00 01 04 10 00 01 04 10 00 01 04 10 00 01 04 10 00 01 04 10 00 01 04 10 00 01 04 10 00 01 04 10 00 01 04 10 00 01 04 10 00 01 04 10 00 01 04 10 00 01 04 10 00 01 04 10 00 01 04 10 00 01 04 10 00 01 04 10 00 01 04 10 00 01 04 10 00 01 04 10 00 01 04 10 00 01 04 10 00 01 04 10 00 01 04 10 00 01 04 10 00 01 04 10 00 01 04 10 00 01 04 10 00 01 04 10 00 01 04 10 00 01 04 10 00 01 04 10 00 01 04 10 00 01 04 10 00 01 04 10 00 01 04 10 00 01 04 10 00 01 04 10 00 01 04 10 00 01 04 10 00 01 04 10 00 01 04 10 00 01 04 10 00 01 04 10 00 01 04 10 00 01 04 10 00 01 04 10 00 01 04 10 00 01 04 10 00 01 04 10 00 01 04 10 00 01 04 10 00 01 04 10 00 01 04 10 00 01 04 10 00 01 04 10 00 01 04 10 00 01 04 10 00 01 04 10 00 01 04 10 00 01 04 10 00 01 04 10 00 01 04 10 00 01 04 10 00 01 04 10 00 01 04 10 00 01 04 10 00 01 04 10 00 01 04 10 00 01 04 10 00 01 04 10 00 01 04 10 00 01 04 10 00 01 04 10 00 01 04 10 00 01 04 10 00 01 04 10 00 01 04 10 00 01 04 10 00 01 04 10 00 01 04 10 00 01 04 10 00 01 04 10 00 01 04 10 00 01 04 10 00 01 04 10 00 01 04 10 00 01 04 10 00 01 04 10 00 01 04 10 00 01 04 10 00 01 04 10 00 01 04 10 00 01 04 10 00 01 04 10 00 01 04 10 00 01 04 10 00 01 04 10 00 01 04 10 00 01 04 10 00 01 04 10 00 01 04 10 00 01 04 10 00 01 04 10 00 01 04 10 00 01 04 10 00 01 04 10 00 01 04 10 00 01 04 10 00 01 04 10 00 01 04 10 00 01 04 10 00 01 04 10 00 01 04 10 00 01 04 10 00 01 04 10 00 01 04 10 00 01 04 10 00 01 04 10 00 01 04 10 00 01 04 10 00 01 04 10 00 01 04 10 00 01 04 10 00 01 04 10 00 01 04 10 00 01 04 10 00 01 04 10 00 01 04 10 00 01 04 10 00 01 04 10 00 01 04 10 00 01 04 10 00 01 04 10 00 01 04 10 00 01 04 10 00 01 04 10 00 01 04 10 00 01 04 10 00 01 04 10 00 01 04 10 00 01 04 10 00 01 04 10 00 01 04 10 00 01 04 10 00 01 04 10 00 01 04 10 00 01 04 10 00 01 04 10 00 01 04 10 00 01 04 10 00 01 04 10 00 01 04 10 00 01 04 10 00 01 04 10 00 01 04 10 00 01 04 10 00 01 04 10 00 01 04 10 00 01 04 10 00 01 04 10 00 01 04 10 00 01 04 10 00 01 04 10 00 01 04 10 00 01 04 10 00 01 04 10 00 01 04 10 00 01 04 10 00 01 04 10 00 01 04 10 00 01 04 10 00 01 04 10 00 01 04 10 00 01 04 10 00 01 04 10 00 01 04 10 00 01 04 10 00 01 04 10 00 01 04 10 00 01 04 10 00 01 04 10 00 01 04 10 00 01 04 10 00 01 04 10 00 01 04 10 00 01 04 10 00 01 04 10 00 01 04 10 00 01 04 10 00 01 04 10 00 01 04 10 00 01 04 10 00 01 04 10 00 01 04 10 00 01 04 10 00 01 04 10 00 01 04 10 00 01 04 10 00 01 04 10 00 01 04 10 00 01 04 10 00 01 04 10 00 01 04 10 00 01 04 10 00 01 04 10 00 01 04 10 00 01 04 10 00 01 04 10 00 01 04 10 00 01 04 10 00 01 04 10 00 01 04 10 00 01 04 10 00 01 04 10 00 01 04 10 00 01 04 10 00 01 04 10 00 01 04 10 00 01 04 10 00 01 04 10 00 01 04 10 00 01 04 10 00 01 04 10 00 01 04 10 00 01 04 10 00 01 04 10 00 01 04 10 00 01 04 10 00 01 04 10 00 01 04 10 00 01 04 10 00 01 04 10 00 01 04 10 00 01 04 10 00 01 04 10 00 01 04 10 00 01 04 10 00 01 04 10 00 01 04 10 00 01 04 10 00 01 04 10 00 01 04 10 00 01 04 10 00 01 04 10 00 01 04 10 00 01 04 10 00 01 04 10 00 01 04 10 00 01 04 10 00 01 04 10 00 01 04 10 00 01 04 10 00 01 04 10 00 01 04 10 00 01 04 10 00 01 04 10 00 01 04 10 00 01 04 10 00 01 04 10 00 01 04 10 00 01 04 10 00 01 04 10 00 01 04 10 00 01 04 10 00 01 04 10 00 01 04 10 00 01 04 10 00 01 04 10 00 01 04 10 00 01 04 10 00 01 04 10 00 01 04 10 00 01 04 10 00 01 04 10 00 01 04 10 00 01 04 10 00 01 04 10 00 01 04 10 00 01 04 10 00 01 04 10 00 01 04 10 00 01 04 10 00 01 04 10 00 01 04 10 00 01 04 10 00 01 04 10 00 01 04 10 00 01 04 10 00 01 04 10 00 01 04 10 00 01 04 10 00 01 04 10 00 01 04 10 00 01 04 10 00 01 04 10 00 01 04 10 00 01 04 10 00 01 04 10 00 01 04 10 00 01 04 10 00 01 04 10 00 01 04 10 00 01 04 10 00 01 04 10 00 01 04 10 00 01 04 10 00 01 04 10 00 01 04 10 00 01 04 10 00 01 04 10 00 01 04 10 00 01 04 10 00 01 04 10 00 01 04 10 00 01 04 10 00 01 04 10 00 01 04 10 00 01 04 10 00 01 04 10 00 01 04 10 00 01 04 10 00 01 04 10 00 01 04 10 00 01 04 10 00 01 04 10 00 01 04 10 00 01 04 10 00 01 04 10 00 01 04 10 00 01 04 10 00 01 04 10 00 01 04 10 00 01 04 10 00 01 04 10 00 01 04 10 00 01 04 10 00 01 04 10 00 01 04 10 00 01 04 10 00 01 04 10 00 01 04 10 00 01 04 10 00 01 04 10 00 01 04 10 00 01 04 10 00 01 04 10 00 01 04 10 00 01 04 10 00 01 04 10 00 01 04 10 00 01 04 10 00 01 04 10 00 01 04 10 00 01 04 10 00 01 04 10 00 01 04 10 00 01 04 10 00 01 04 10 00 01 04 10 00 01 04 10 00 01 04 10 00 01 04 10 00 01 04 10 00 01 04 10 00 01 04 10 00 01 04 10 00 01 04 10 00 01 04 10 00 01 04 10 00 01 04 10 00 01 04 10 00 01 04 10 00 01 04 10 00 01 04 10 00 01 04 10 00 01 04 10 00 01 04 10 00 01 04 10 00 01 04 10 00 01 04 10 00 01 04 10 00 01 04 10 00 01 04 10 00 01 04 10 00 01 04 10 00 01 04 10 00 01 04 10 00 01 04 10 00 01 04 10 00 01 04 10 00 01 04 10 00 01 04 10 00 01 04 10 00 01 04 10 00 01 04 10 00 01 04 10 00 01 04 10 00 01 04 10 00 01 04 10 00 01 04 10 00 01 04 10 00 01 04 10 00 01 04 10 00 01 04 10 00 01 04 10 00 01 04 10 00 01 04 10 00 01 04 10 00 01 04 10 00 01 04 10 00 01 04 10 00 01 04 10 00 01 04 10 00 01 04 10 00 01 04 10 00 01 04 10 00 01 04 10 00 01 04 10 00 01 04 10 00 01 04 10 00 01 04 10 00 01 04 10 00 01 04 10 00 01 04 10 00 01 04 10 00 01 04 10 00 01 04 10 00 01 04 10 00 01 04 10 00 01 04 10 00 01 04 10 00 01 04 10 00 01 04 10 00 01 04 10 00 01 04 10 00 01 04 10 00 01 04 10 00 01 04 10 00 01 04 10 00 01 04 10 00 01 04 10 00 01 04 10 00 01 04 10 00 01 04 10 00 01 04 10 00 01 04 10 00 01 04 10 00 01 04 10 00 01 04 10 00 01 04 10 00 01 04 10 00 01 04 10 00 01 04 10 00 01 04 10 00 01 04 10 00 01 04 10 00 01 04 10 00 01 04 10 00 01 04 10 00 01 04 10 00 01 04 10 00 01 04 10 00 01 04 10 00 01 04 10 00 01 04 10 00 01 04 10 00 01 04 10 00 01 04 10 00 01 04 10 00 01 04 10 00 01 04 10 00 01 04 10 00 01 04 10 00 01 04 10 00 01 04 10 00 01 04 10 00 01 04 10 00 01 04 10 00 01 04 10 00 01 04 10 00 01 04 10 00 01 04 10 00 01 04 10 00 01 04 10 00 01 04 10 00 01 04 10 00 01 04 10 00 01 04 10 00 01 04 10 00 01 04 10 00 01 04 10 00 01 04 10 00 01 04 10 00 01 04 10 00 01 04 10 00 01 04 10 00 01 04 10 00 01 04 10 00 01 04 10 00 01 04 10 00 01 04 10 00 01 04 10 00 01 04 10 00 01 04 10 00 01 04 10 00 01 04 10 00 01 04 10 00 01 04 10 00 01 04 10 00 01 04 10 00 01 04 10 00 01 04 10 00 01 04 10 00 01 04 10 00 01 04 10 00 01 04 10 00 01 04 10 00 01 04 10 00 01 04 10 00 01 04 10 00 01 04 10 00 01 04 10 00 01 04 10 00 01 04 10 00 01 04 10 00 01 04 10 00 01 04 10 00 01 04 10 00 01 04 10 00 01 04 10 00 01 04 10 00 01 04 10 00 01 04 10 00 01 04 10 00 01 04 10 00 01 04 10 00 01 04 10 00 01 04 10 00 01 04 10 00 01 04 10 00 01 04 10 00 01 04 10 00 01 04 10 00 01 04 10 00 01 04 10 00 01 04 10 00 01 04 10 00 01 04 10 00 01 04 10 00 01 04 10 00 01 04 10 00 01 04 10 00 01 04 10 00 01 04 10 00 01 04 10 00 01 04 10 00 01 04 10 00 01 04 10 00 01 04 10 00 01 04 10 00 01 04 10 00 01 04 10 00 01 04 10 00 01 04 10 00 01 04 10 00 01 04 10 00 01 04 10 00 01 04 10 00 01 04 10 00 01 04 10 00 01 04 10 00 01 04 10 00 01 04 10 00 01 04 10 00 01 04 10 00 01 04 10 00 01 04 10 00 01 04 10 00 01 04 10 00 01 04 10 00 01 04 10 00 01 04 10 00 01 04 10 00 01 04 10 00 01 04 10 00 01 04 10 00 01 04 10 00 01 04 10 00 01 04 10 00 01 04 10 00 01 04 10 00 01 04 10 00 01 04 10 00 01 04 10 00 01 04 10 00 01 04 10 00 01 04 10 00 01 04 10 00 01 04 10 00 01 04 10 00 01 04 10 00 01 04 10 00 01 04 10 00 01 04 10 00 01 04 10 00 01 04 10 00 01 04 10 00 01 04 10 00 01 04 10 00 01 04 10 00 01 04 10 00 01 04 10 00 01 04 10 00 01 04 10 00 01 04 10 00 01 04 10 00 01 04 10 00 01 04 10 00 01 04 10 00 01 04 10 00 01 04 10 00 01 04 10 00 01 04 10 00 01 04 10 00 01 04 10 00 01 04 10 00 01 04 10 00 01 04 10 00 01 04 10 00 01 04 10 00 01 04 10 00 01 04 10 00 01 04 10 00 01 04 10 00 01 04 10 00 01 04 10 00 01 04 10 00 01 04 10 00 01 04 10 00 01 04 10 00 01 04 10 00 01 04 10 00 01 04 10 00 01 04 10 00 01 04 10 00 01 04 10 00 01 04 10 00 01 04 10 00 01 04 10 00 01 04 10 00 01 04 10 00 01 04 10 00 01 04 10 00 01 04 10 00 01 04 10 00 01 04 10 00 01 04 10 00 01 04 10 00 01 04 10 00 01 04 10 00 01 04 10 00 01 04 10 00 01 04 10 00 01 04 10 00 01 04 10 00 01 04 10 00 01 04 10 00 01 04 10 00 01 04 10 00 01 04 10 00 01 04 10 00 01 04 10 00 01 04 10 00 01 04 10 00 01 04 10 00 01 04 10 00 01 04 10 00 01 04 10 00 01 04 10 00 01 04 10 00 01 04 10 00 01 04 10 00 01 04 10 00 01 04 10 00 01 04 10 00 01 04 10 00 01 04 10 00 01 04 10 00 01 04 10 00 01 04 10 00 01 04 10 00 01 04 10 00 01 04 10 00 01 04 10 00 01 04 10 00 01 04 10 00 01 04 10 00 01 04 10 00 01 04 10 00 01 04 10 00 01 04 10 00 01 04 10 00 01 04 10 00 01 04 10 00 01 04 10 00 01 04 10 00 01 04 10 00 01 04 10 00 01 04 10 00 01 04 10 00 01 04 10 00 01 04 10 00 01 04 10 00 01 04 10 00 01 04 10 00 01 04 10 00 01 04 10 00 01 04 10 00 01 04 10 00 01 04 10 00 01 04 10 00 01 04 10 00 01 04 10 00 01 04 10 00 01 04 10 00 01 04 10 00 01 04 10 00 01 04 10 00 01 04 10 00 01 04 10 00 01 04 10 00 01 04 10 00 01 04 10 00 01 04 10 00 01 04 10 00 01 04 10 00 01 04 10 00 01 04 10 00 01 04 10 00 01 04 10 00 01 04 10 00 01 04 10 00 01 04 10 00 01 04 10 00 01 04 10 00 01 04 10 00 01 04 10 00 01 04 10 00 01 04 10 00 01 04 10 00 01 04 10 00 01 04 10 00 01 04 10 00 01 04 10 00 01 04 10 00 01 04 10 00 01 04 10 00 01 04 10 00 01 04 10 00 01 04 10 00 01 04 10 00 01 04 10 00 01 04 10 00 01 04 10 00 01 04 10 00 01 04 10 00 01 04 10 00 01 04 10 00 01 04 10 00 01 04 10 00 01 04 10 00 01 04 10 00 01 04 10 00 01 04 10 00 01 04 10 00 01 04 10 00 01 04 10 00 01 04 10 00 01 04 10 00 01 04 10 00 01 04 10 00 01 04 10 00 01 04 10 00 01 04 10 00 01 04 10 00 01 04 10 00 01 04 10 00 01 04 10 00 01 04 10 00 01 04 10 00 01 04 10 00 01 04 10 00 01 04 10 00 01 04 10 00 01 04 10 00 01 04 10 00 01 04 10 00 01 04 10 00 01 04 10 00 01 04 10 00 01 04 10 00 01 04 10 00 01 04 10 00 01 04 10 00 01 04 10 00 01 04 10 00 01 04 10 00 01 04 10 00 01 04 10 00 01 04 10 00 01 04 10 00 01 04 10 00 01 04 10 00 01 04 10 00 01 04 10 00 01 04 10 00 01 04 10 00 01 04 10 00 01 04 10 00 01 04 10 00 01 04 10 00 01 04 10 00 01 04 10 00 01 04 10 00 01 04 10 00 01 04 10 00 01 04 10 00 01 04 10 00 01 04 10 00 01 04 10 00 01 04 10 00 01 04 10 00 01 04 10 00 01 04 10 00 01 04 10 00 01 04 10 00 01 04 10 00 01 04 10 00 01 04 10 00 01 04 10 00 01 04 10 00 01 04 10 00 01 04 10 00 01 04 10 00 01 04 10 00 01 04 10 00 01 04 10 00 01 04 10 00 01 04 10 00 01 04 10 00 01 04 10 00 01 04 10 00 01 04 10 00 01 04 10 00 01 04 10 00 01 04 10 00 01 04 10 00 01 04 10 00 01 04 10 00 01 04 10 00 01 04 10 00 01 04 10 00 01 04 10 00 01 04 10 00 01 04 10 00 01 04 10 00 01 04 10 00 01 04 10 00 01 04 10 00 01 04 10 00 01 04 10 00 01 04 10 00 01 04 10 00 01 04 10 00 01 04 10 00 01 04 10 00 01 04 10 00 01 04 10 00 01 04 10 00 01 04 10 00 01 04 10 00 01 04 10 00 01 04 10 00 01 04 10 00 01 04 10 00 01 04 10 00 01 04 10 00 01 04 10 00 01 04 10 00 01 04 10 00 01 04 10 00 01 04 10 00 01 04 10 00 01 04 10 00 01 04 10 00 01 04 10 00 01 04 10 00 01 04 10 00 01 04 10 00 01 04 10 00 01 04 10 00 01 04 10 00 01 04 10 00 01 04 10 00 01 04 10 00 01 04 10 00 01 04 10 00 01 04 10 00 01 04 10 00 01 04 10 00 01 04 10 00 01 04 10 00 01 04 10 00 01 04 10 00 01 04 10 00 01 04 10 00 01 04 10 00 01 04 10 00 01 04 10 00 01 04 10 00 01 04 10 00 01 04 10 00 01 04 10 00 01 04 10 00 01 04 10 00 01 04 10 00 01 04 10 00 01 04 10 00 01 04 10 00 01 04 10 00 01 04 10 00 01 04 10 00 01 04 10 00 01 04 10 00 01 04 10 00 01 04 10 00 01 04 10 00 01 04 10 00 01 04 10 00 01 04 10 00 01 04 10 00 01 04 10 00 01 04 10 00 01 04 10 00 01 04 10 00 01 04 10 00 01 04 10 00 01 04 10 00 01 04 10 00 01 04 10 00 01 04 10 00 01 04 10 00 01 04 10 00 01 04 10 00 01 04 10 00 01 04 10 00 01 04 10 00 01 04 10 00 01 04 10 00 01 04 10 00 01 04 10 00 01 04 10 00 01 04 10 00 01 04 10 00 01 04 10 00 01 04 10 00 01 04 10 00 01 04 10 00 01 04 10 00 01 04 10 00 01 04 10 00 01 04 10 00 01 04 10 00 01 04 10 00 01 04 10 00 01 04 10 00 01 04 10 00 01 04 10 00 01 04 10 00 01 04 10 00 01 04 10 00 01 04 10 00 01 04 10 00 01 04 10 00 01 04 10 00 01 04 10 00 01 04 10 00 01 04 10 00 01 04 10 00 01 04 10 00 01 04 10 00 01 04 10 00 01 04 10 00 01 04 10 00 01 04 10 00 01 04 10 00 01 04 10 00 01 04 10 00 01 04 10 00 01 04 10 00 01 04 10 00 01 04 10 00 01 04 10 00 01 04 10 00 01 04 10 00 01 04 10 00 01 04 10 00 01 04 10 00 01 04 10 00 01 04 10 00 01 04 10 00 01 04 10 00 01 04 10 00 01 04 10 00 01 04 10 00 01 04 10 00 01 04 10 00 01 04 10 00 01 04 10 00 01 04 10 00 01 04 10 00 01 04 10 00 01 04 10 00 01 04 10 00 01 04 10 00 01 04 10 00 01 04 10 00 01 04 10 00 01 04 10 00 01 04 10 00 01 04 10 00 01 04 10 00 01 04 10 00 01 04 10 00 01 04 10 00 01 04 10 00 01 04 10 00 01 04 10 00 01 04 10 00 01 04 10 00 01 04 10 00 01 04 10 00 01 04 10 00 01 04 10 00 01 04 10 00 01 04 10 00 01 04 10 00 01 04 10 00 01 04 10 00 01 04 10 00 01 04 10 00 01 04 10 00 01 04 10 00 01 04 10 00 01 04 10 00 01 04 10 00 01 04 10 00 01 04 10 00 01 04 10 00 01 04 10 00 01 04 10 00 01 04 10 00 01 04 10 00 01 04 10 00 01 04 10 00 01 04 10 00 01 04 10 00 01 04 10 00 01 04 10 00 01 04 10 00 01 04 10 00 01 04 10 00 01 04 10 00 01 04 10 00 01 04 10 00 01 04 10 00 01 04 10 00 01 04 10 00 01 04 10 00 01 04 10 00 01 04 10 00 01 04 10 00 01 04 10 00 01 04 10 00 01 04 10 00 01 04 10 00 01 04 10 00 01 04 10 00 01 04 10 00 01 04 10 00 01 04 10 00 01 04 10 00 01 04 10 00 01 04 10 00 01 04 10 00 01 04 10 00 01 04 10 00 01 04 10 00 01 04 10 00 01 04 10 00 01 04 10 00 01 04 10 00 01 04 10 00 01 04 10 00 01 04 10 00 01 04 10 00 01 04 10 00 01 04 10 00 01 04 10 00 01 04 10 00 01 04 10 00 01 04 10 00 01 04 10 00 01 04 10 00 01 04 10 00 01 04 10 00 01 04 10 00 01 04 10 00 01 04 10 00 01 04 10 00 01 04 10 00 01 04 10 00 01 04 10 00 01 04 10 00 01 04 10 00 01 04 10 00 01 04 10 00 01 04 10 00 01 04 10 00 01 04 10 00 01 04 10 00 01 04 10 00 01 04 10 00 01 04 10 00 01 04 10 00 01 04 10 00 01 04 10 00 01 04 10 00 01 04 10 00 01 04 10 00 01 04 10 00 01 04 10 00 01 04 10 00 01 04 10 00 01 04 10 00 01 04 10 00 01 04 10 00 01 04 10 00 01 04 10 00 01 04 10 00 01 04 10 00 01 04 10 00 01 04 10 00 01 04 10 00 01 04 10 00 01 04 10 00 01 04 10 00 01 04 10 00 01 04 10 00 01 04 10 00 01 04 10 00 01 04 10 00 01 04 10 00 01 04 10 00 01 04 10 00 01 04 10 00 01 04 10 00 01 04 10 00 01 04 10 00 01 04 10 00 01 04 10 00 01 04 10 00 01 04 10 00 01 04 10 00 01 04 10 00 01 04 10 00 01 04 10 00 01 04 10 00 01 04 10 00 01 04 10 00 01 04 10 00 01 04 10 00 01 04 10 00 01 04 10 00 01 04 10 00 01 04 10 00 01 04 10 00 01 04 10 00 01 04 10 00 01 04 10 00 01 04 10 00 01 04 10 00 01 04 10 00 01 04 10 00 01 04 10 00 01 04 10 00 01 04 10 00 01 04 10 00 01 04 10 00 01 04 10 00 01 04 10 00 01 04 10 00 01 04 10 00 01 04 10 00 01 04 10 00 01 04 10 00 01 04 10 00 01 04 10 00 01 04 10 00 01 04 10 00 01 04 10 00 01 04 10 00 01 04 10 00 01 04 10 00 01 04 10 00 01 04 10 00 01 04 10 00 01 04 10 00 01 04 10 00 01 04 10 00 01 04 10 00 01 04 10 00 01 04 10 00 01 04 10 00 01 04 10 00 01 04 10 00 01 04 10 00 01 04 10 00 01 04 10 00 01 04 10 00 01 04 10 00 01 04 10 00 01 04 10 00 01 04 10 00 01 04 10 00 01 04 10 00 01 04 10 00 01 04 10 00 01 04 10 00 01 04 10 00 01 04 10 00 01 04 10 00 01 04 10 00 01 04 10 00 01 04 10 00 01 04 10 00 01 04 10 00 01 04 10 00 01 04 10 00 01 04 10 00 01 04 10 00 01 04 10 00 01 04 10 00 01 04 10 00 01 04 10 00 01 04 10 00 01 04 10 00 01 04 10 00 01 04 10 00 01 04 10 00 01 04 10 00 01 04 10 00 01 04 10 00 01 04 10 00 01 04 10 00 01 04 10 00 01 04 10 00 01 04 10 00 01 04 10 00 01 04 10 00 01 04 10 00 01 04 10 00 01 04 10 00 01 04 10 00 01 04 10 00 01 04 10 00 01 04 10 00 01 04 10 00 01 04 10 00 01 04 10 00 01 04 10 00 01 04 10 00 01 04 10 00 01 04 10 00 01 04 10 00 01 04 10 00 01 04 10 00 01 04 10 00 01 04 10 00 01 04 10 00 01 04 10 00 01 04 10 00 01 04 10 00 01 04 10 00 01 04 10 00 01 04 10 00 01 04 10 00 01 04 10 00 01 04 10 00 01 04 10 00 01 04 10 00 01 04 10 00 01 04 10 00 01 04 10 00 01 04 10 00 01 04 10 00 01 04 10 00 01 04 10 00 01 04 10 00 01 04 10 00 01 04 10 00 01 04 10 00 01 04 10 00 01 04 10 00 01 04 10 00 01 04 10 00 01 04 10 00 01 04 10 00 01 04 10 00 01 04 10 00 01 04 10 00 01 04 10 00 01 04 10 00 01 04 10 00 01 04 10 00 01 04 10 00 01 04 10 00 01 04 10 00 01 04 10 00 01 04 10 00 01 04 10 00 01 04 10 00 01 04 10 00 01 04 10 00 01 04 10 00 01 04 10 00 01 04 10 00 01 04 10 00 01 04 10 00 01 04 10 00 01 04 10 00 01 04 10 00 01 04 10 00 01 04 10 00 01 04 10 00 01 04 10 00 01 04 10 00 01 04 10 00 01 04 10 00 01 04 10 00 01 04 10 00 01 04 10 00 01 04 10 00 01 04 10 00 01 04 10 00 01 04 10 00 01 04 10 00 01 04 10 00 01 04 10 00 01 04 10 00 01 04 10 00 01 04 10 00 01 04 10 00 01 04 10 00 01 04 10 00 01 04 10 00 01 04 10 00 01 04 10 00 01 04 10 00 01 04 10 00 01 04 10 00 01 04 10 00 01 04 10 00 01 04 10 00 01 04 10 00 01 04 10 00 01 04 10 00 01 04 10 00 01 04 10 00 01 04 10 00 01 04 10 00 01 04 10 00 01 04 10 00 01 04 10 00 01 04 10 00 01 04 10 00 01 04 10 00 01 04 10 00 01 04 10 00 01 04 10 00 01 04 10 00 01 04 10 00 01 04 10 00 01 04 10 00 01 04 10 00 01 04 10 00 01 04 10 00 01 04 10 00 01 04 10 00 01 04 10 00 01 04 10 00 01 04 10 00 01 04 10 00 01 04 10 00 01 04 10 00 01 04 10 00 01 04 10 00 01 04 10 00 01 04 10 00 01 04 10 00 01 04 10 00 01 04 10 00 01 04 10 00 01 04 10 00 01 04 10 00 01 04 10 00 01 04 10 00 01 04 10 00 01 04 10 00 01 04 10 00 01 04 10 00 01 04 10 00 01 04 10 00 01 04 10 00 01 04 10 00 01 04 10 00 01 04 10 00 01 04 10 00 01 04 10 00 01 04 10 00 01 04 10 00 01 04 10 00 01 04 10 00 01 04 10 00 01 04 10 00 01 04 10 00 01 04 10 00 01 04 10 00 01 04 10 00 01 04 10 00 01 04 10 00 01 04 10 00 01 04 10 00 01 04 10 00 01 04 10 00 01 04 10 00 01 04 10 00 01 04 10 00 01 04 10 00 01 04 10 00 01 04 10 00 01 04 10 00 01 04 10 00 01 04 10 00 01 04 10 00 01 04 10 00 01 04 10 00 01 04 10 00 01 04 10 00 01 04 10 00 01 04 10 00 01 04 10 00 01 04 10 00 01 04 10 00 01 04 10 00 01 04 10 00 01 04 10 00 01 04 10 00 01 04 10 00 01 04 10 00 01 04 10 00 01 04 10 00 01 04 10 00 01 04 10 00 01 04 10 00 01 04 10 00 01 04 10 00 01 04 10 00 01 04 10 00 01 04 10 00 01 04 10 00 01 04 10 00 01 04 10 00 01 04 10 00 01 04 10 00 01 04 10 00 01 04 10 00 01 04 10 00 01 04 10 00 01 04 10 00 01 04 10 00 01 04 10 00 01 04 10 00 01 04 10 00 01 04 10 00 01 04 10 00 01 04 10 00 01 04 10 00 01 04 10 00 01 04 10 00 01 04 10 00 01 04 10 00 01 04 10 00 01 04 10 00 01 04 10 00 01 04 10 00 01 04 10 00 01 04 10 00 01 04 10 00 01 04 10 00 01 04 10 00 01 04 10 00 01 04 10 00 01 04 10 00 01 04 10 00 01 04 10 00 01 04 10 00 01 04 10 00 01 04 10 00 01 04 10 00 01 04 10 00 01 04 10 00 01 04 10 00 01 04 10 00 01 04 10 00 01 04 10 00 01 04 10 00 01 04 10 00 01 04 10 00 01 04 10 00 01 04 10 00 01 04 10 00 01 04 10 00 01 04 10 00 01 04 10 00 01 04 10 00 01 04 10 00 01 04 10 00 01 04 10 00 01 04 10 00 01 04 10 00 01 04 10 00 01 04 10 00 01 04 10 00 01 04 10 00 01 04 10 00 01 04 10 00 01 04 10 00 01 04 10 00 01 04 10 00 01 04 10 00 01 04 10 00 01 04 10 00 01 04 10 00 01 04 10 00 01 04 10 00 01 04 10 00 01 04 10 00 01 04 10 00 01 04 10 00 01 04 10 00 01 04 10 00 01 04 10 00 01 04 10 00 01 04 10 00 01 04 10 00 01 04 10 00 01 04 10 00 01 04 10 00 01 04 10 00 01 04 10 00 01 04 10 00 01 04 10 00 01 04 10 00 01 04 10 00 01 04 10 00 01 04 10 00 01 04 10 00 01 04 10 00 01 04 10 00 01 04 10 00 01 04 10 00 01 04 10 00 01 04 10 00 01 04 10 00 01 04 10 00 01 04 10 00 01 04 10 00 01 04 10 00 01 04 10 00 01 04 10 00 01 04 10 00 01 04 10 00 01 04 10 00 01 04 10 00 01 04 10 00 01 04 10 00 01 04 10 00 01 04 10 00 01 04 10 00 01 04 10 00 01 04 10 00 01 04 10 00 01 04 10 00 01 04 10 00 01 04 10 00 01 04 10 00 01 04 10 00 01 04 10 00 01 04 10 00 01 04 10 00 01 04 10 00 01 04 10 00 01 04 10 00 01 04 10 00 01 04 10 00 01 04 10 00 01 04 10 00 01 04 10 00 01 04 10 00 01 04 10 00 01 04 10 00 01 04 10 00 01 04 10 00 01 04 10 00 01 04 10 00 01 04 10 00 01 04 10 00 01 04 10 00 01 04 10 00 01 04 10 00 01 04 10 00 01 04 10 00 01 04 10 00 01 04 10 00 01 04 10 00 01 04 10 00 01 04 10 00 01 04 10 00 01 04 10 00 01 04 10 00 01 04 10 00 01 04 10 00 01 04 10 00 01 04 10 00 01 04 10 00 01 04 10 00 01 04 10 00 01 04 10 00 01 04 10 00 01 04 10 00 01 04 10 00 01 04 10 00 01 04 10 00 01 04 10 00 01 04 10 00 01 04 10 00 01 04 10 00 01 04 10 00 01 04 10 00 01 04 10 00 01 04 10 00 01 04 10 00 01 04 10 00 01 04 10 00 01 04 10 00 01 04 10 00 01 04 10 00 01 04 10 00 01 04 10 00 01 04 10 00 01 04 10 00 01 04 10 00 01 04 10 00 01 04 10 00 01 04 10 00 01 04 10 00 01 04 10 00 01 04 10 00 01 04 10 00 01 04 10 00 01 04 10 00 01 04 10 00 01 04 10 00 01 04 10 00 01 04 10 00 01 04 10 00 01 04 10 00 01 04 10 00 01 04 10 00 01 04 10 00 01 04 10 00 01 04 10 00 01 04 10 00 01 04 10 00 01 04 10 00 01 04 10 00 01 04 10 00 01 04 10 00 01 04 10 00 01 04 10 00 01 04 10 00 01 04 10 00 01 04 10 00 01 04 10 00 01 04 10 00 01 04 10 00 01 04 10 00 01 04 10 00 01 04 10 00 01 04 10 00 01 04 10 00 01 04 10 00 01 04 10 00 01 04 10 00 01 04 10 00 01 04 10 00 01 04 10 00 01 04 10 00 01 04 10 00 01 04 10 00 01 04 10 00 01 04 10 00 01 04 10 00 01 04 10 00 01 04 10 00 01 04 10 00 01 04 10 00 01 04 10 00 01 04 10 00 01 04 10 00 01 04 10 00 01 04 10 00 01 04 10 00 01 04 10 00 01 04 10 00 01 04 10 00 01 04 10 00 01 04 10 00 01 04 10 00 01 04 10 00 01 04 10 00 01 04 10 00 01 04 10 00 01 04 10 00 01 04 10 00 01 04 10 00 01 04 10 00 01 04 10 f4 01 00 00 f4 01 00 00 90 01 00 00 40 06 00 00 00 00 00 00 01 00 00 00 04 00 00 00 07 00 00 00 0a 00 00 00 0d 00 00 00 17 00 00 00 24 00 00 00 39 00 00 00 52 00 00 00 70 00 00 00 90 00 00 00 c6 00 00 00 03 01 00 00 77 01 00 00 4a 02 00 00 ff 03 00 00];
		};
	};
};
