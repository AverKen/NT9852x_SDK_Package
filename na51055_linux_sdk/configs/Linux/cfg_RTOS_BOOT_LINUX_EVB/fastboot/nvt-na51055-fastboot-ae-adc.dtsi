/*
 * Novatek Ltd. NA51055 BSP part of dts
 *
 * Cortex-A9
 *
 */

&fastboot {
    ae_adc_table {
    		valid = <0>;
    		def_sen_expt = <10000>;
    		def_sen_gain = <1000>;
    		def_isp_gain = <128>;
    		adc_tbl_thr = <2000>;
    		ir_mode_en = <0>;
    		ir_mode_thr = <50>;
    		size = <216>;
    		adc_expt_gain_0 = 
          <1550    36   1000>,
          <1550    70   1000>,
          <1550   140   1000>,
          <1545   282   1000>,
          <1540   587   1000>,
          <1538  1261   1000>,
          <1534  2653   1000>,
          <1524  4837   1000>,
          <1188 10000   1050>,
          < 613 20000   1100>,
          < 321 30000   1390>,
          < 164 30000   2680>,
          <  80 30000   5170>,
          <  40 30000  10530>,
          <  22 30000  49670>,
          <   5 30000 111000>,
          <   2 30000 124000>,
          <   0 30000 124000>;
    		adc_expt_gain_1 = 
          <1550	   30	  100>,
          <1550    67	  100>,
          <1550   145	  100>,
          <1540   284	  100>,
          <1540   577	  100>,
          <1543  1174	  100>,
          <1527  2381	  100>,
          <1477  4583	  100>,
          < 836  9096	  100>,
          < 432 10000	  191>,
          < 226 20000	  183>,
          < 115 30000	  223>,
          <  57 30000	  483>,
          <  34 30000	  815>,
          <  22 30000	 4967>,
          <   5 30000	11100>,
          <   2 30000	12400>,
          <   0 30000	12400>;
	};
};
