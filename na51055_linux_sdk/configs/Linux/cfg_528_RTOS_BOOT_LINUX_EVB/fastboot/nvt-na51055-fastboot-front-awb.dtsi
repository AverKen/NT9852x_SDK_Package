/*
 * Novatek Ltd. NA51055 BSP part of dts
 *
 * Cortex-A9
 *
 */

&fastboot {
    front_awb_0 {
        enable {
			      size = [04 00 00 00];
			      data = [00 00 00 00];
		        };
        color_gain {
			      size = [0c 00 00 00];
			      data = [00 01 00 00 00 01 00 00 00 01 00 00];
		        };
		};
};
